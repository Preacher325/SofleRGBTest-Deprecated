## config/west.yml
```yaml
manifest:
  remotes:
    - name: Preacher325
      url-base: https://github.com/Preacher325
  projects:
    - name: zmk
      remote: Preacher325
      revision: main
      import: app/west.yml
  self:
    path: config
```
